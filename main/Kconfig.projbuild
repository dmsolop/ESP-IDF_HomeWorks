## main/Kconfig.projbuild
```kconfig
menu "Homework Selection"

choice HOMEWORK_TASK
    prompt "Select Active Homework"
    default HW_02_3_SUPERLOOP

config HW_02_3_SUPERLOOP
    bool "HW 02_3: Superloop 3 LEDs"

config HW_02_4_1_HW_INTERRUPTS
    bool "HW 02_4_1: HW Interrupts"

config HW_02_4_2_HW_INTERRUPTS
    bool "HW 02_4_2: HW_Interrupts"

config HW_02_4_3_HW_INTERRUPTS
    bool "HW 02_4_3: HW_Interrupts"

config HW_02_4_4_HW_INTERRUPTS
    bool "HW 02_4_4: HW_Interrupts"

config HW_02_5_EXHAUST_FAN
    bool "HW 02_5: Exhaust Fan Control"

config MINI_PROJ_TRAFFIC_LIGHT
    bool "Mini Project: Smart Traffic Light"

config HW_03_1_ADC_CALIB
    bool "HW 03_1: ADC Data Calibration"

config HW_03_2_ADC_EMA
    bool "HW 03_2: SMA and LDR"

config HW_03_3_PWM_CONTROL
    bool "HW 03_3: PWM Motor & LED Control"

config HW_03_4_BUZZER_PWM
    bool "HW 03_4: Non-blocking PWM Buzzer Player"

config CW_SERVO_POT
    bool "Classwork: Servo Control via Potentiometer (LEDC + ADC)"

config HW_03_5_SERVO_CONTROL
    bool "HW 03_5: Servo Control via PWM & Potentiometer"

endchoice

endmenu

if HW_02_5_EXHAUST_FAN

menu "Exhaust Fan Parameters"

    config EXHAUST_FAN_WORK_TIME_MIN
        int "Fan working duration (units)"
        default 15
        help
            Duration of fan working state.

    config EXHAUST_FAN_PAUSE_TIME_MIN
        int "Fan pause duration (units)"
        default 45
        help
            Duration of fan pause state.

    config EXHAUST_FAN_DEBUG_MODE
        bool "Enable fast debug mode (seconds instead of minutes)"
        default y
        help
            Scales units to seconds for quick testing.

endmenu

endif

if MINI_PROJ_TRAFFIC_LIGHT

menu "Traffic Light Configuration"

    menu "GPIO Configuration"
        config TRAFFIC_PIN_LED_RED
            int "Red LED GPIO"
            default 21

        config TRAFFIC_PIN_LED_YELLOW
            int "Yellow LED GPIO"
            default 22

        config TRAFFIC_PIN_LED_GREEN
            int "Green LED GPIO"
            default 23

        config TRAFFIC_PIN_BUTTON
            int "Pedestrian Button GPIO"
            default 18

        config TRAFFIC_PIN_BUZZER
            int "Buzzer GPIO"
            default 19

        config TRAFFIC_ADC_CHANNEL_LDR
            int "LDR ADC Channel (e.g. 6 for GPIO34)"
            default 6
    endmenu

    menu "Traffic Light Timings (ms)"
        config TRAFFIC_TIME_GREEN
            int "Green phase duration (ms)"
            default 10000

        config TRAFFIC_TIME_GREEN_FLASH
            int "Green flashing duration (ms)"
            default 3000

        config TRAFFIC_TIME_YELLOW
            int "Yellow phase duration (ms)"
            default 2000

        config TRAFFIC_TIME_RED
            int "Red phase duration (ms)"
            default 10000

        config TRAFFIC_TIME_RED_YELLOW
            int "Red+Yellow phase duration (ms)"
            default 2000
            
        config TRAFFIC_DEBOUNCE_TIME
            int "Button debounce time (us)"
            default 50000
    endmenu

    menu "LDR Sensor Thresholds"
        config TRAFFIC_LDR_NIGHT_THRESHOLD
            int "Night threshold (ADC below this is Night)"
            default 1000

        config TRAFFIC_LDR_DAY_THRESHOLD
            int "Day threshold (ADC above this is Day)"
            default 1500
    endmenu

endmenu

endif

if HW_03_2_ADC_EMA

menu "LDR Sensor Thresholds"
    config ADC_CHANNEL_LDR
        int "LDR ADC Channel (e.g. 7 for GPIO8)"
        default 7

    config LDR_NIGHT_THRESHOLD
        int "Night threshold (mV)"
        default 800

    config LDR_DAY_THRESHOLD
        int "Day threshold (mV)"
        default 1200
endmenu

endif

if HW_03_1_ADC_CALIB

menu "HW 03_1: ADC Calibration Configuration"

    config HW_03_1_ADC_CHANNEL
        int "Potentiometer ADC Channel (e.g. 7 for GPIO8)"
        default 7

    config HW_03_1_VREF_NOMINAL_MV
        int "Nominal Reference / Max Voltage (mV)"
        default 3300

    config HW_03_1_READ_INTERVAL_MS
        int "Measurement Interval (ms)"
        default 100

endmenu

endif

if CW_SERVO_POT

menu "Classwork: Servo & Potentiometer Configuration"

    config CW_SERVO_GPIO
        int "Servo Motor PWM GPIO"
        default 18

    config CW_POT_ADC_CHANNEL
        int "Potentiometer ADC Channel (e.g. 7 for GPIO8)"
        default 7

    config CW_SERVO_MIN_PULSE_US
        int "Min Pulse Width (us) for 0 deg"
        default 1000

    config CW_SERVO_MAX_PULSE_US
        int "Max Pulse Width (us) for 180 deg"
        default 2000

endmenu

endif

if HW_03_3_PWM_CONTROL

menu "HW 03_3: PWM Configuration"
    config HW_03_3_ADC_POT
        int "Potentiometer ADC Channel (e.g. 7 for GPIO8)"
        default 7

    config HW_03_3_LED_GPIO
        int "LED GPIO"
        default 17

    config HW_03_3_MOTOR_GPIO
        int "Motor GPIO"
        default 18
endmenu

endif

if HW_03_4_BUZZER_PWM

menu "HW 03_4: Buzzer Configuration"
    config HW_03_4_BUZZER_GPIO
        int "Buzzer GPIO Num"
        default 15
endmenu

endif

if HW_03_5_SERVO_CONTROL

menu "HW 03_5: Servo Configuration"

    config HW_03_5_SERVO_GPIO
        int "Servo Signal GPIO Num"
        default 18
        help
            GPIO пін для виводу керуючого ШІМ-сигналу (50 Гц) на сервопривод.

    config HW_03_5_POT_ADC_CHANNEL
        int "Potentiometer ADC Channel Num (ADC1)"
        default 7
        help
            Номер каналу ADC1 для зчитування потенціометра (ADC_CHANNEL_7 для GPIO 8 і таке інше).

    config HW_03_5_SERVO_MIN_PULSE_US
        int "Servo Min Pulse Width (us)"
        default 500
        help
            Тривалість імпульсу ШІМ для кута 0 градусів мкс.

    config HW_03_5_SERVO_MAX_PULSE_US
        int "Servo Max Pulse Width (us)"
        default 2500
        help
            Тривалість імпульсу ШІМ для максимального кута мкс.

endmenu

endif
```
